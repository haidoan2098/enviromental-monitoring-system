## meta-envmon/conf/layer.conf
```bitbake
BBPATH .= ":${LAYERDIR}"

BBFILES += "${LAYERDIR}/recipes-*/*/*.bb \
            ${LAYERDIR}/recipes-*/*/*.bbappend"

BBFILE_COLLECTIONS += "envmon"
BBFILE_PATTERN_envmon = "^${LAYERDIR}/"
BBFILE_PRIORITY_envmon = "10"

LAYERDEPENDS_envmon = "core"
LAYERSERIES_COMPAT_envmon = "scarthgap"
```
